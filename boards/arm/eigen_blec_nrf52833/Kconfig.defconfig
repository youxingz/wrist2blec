## boards/arm/eigen_blec_nrf52833/Kconfig.defconfig
```kconfig
if BOARD_EIGEN_BLEC_NRF52833

config BOARD
	default "eigen_blec_nrf52833"

# config BT_CTLR
# 	default BT

endif # BOARD_EIGEN_BLEC_NRF52833
```

## boards/arm/eigen_blec_nrf52833/board.yml
```yaml
board:
  name: eigen_blec_nrf52833
  full_name: Eigeneuro nRF52833 Custom Board
  vendor: eigeneuro
  socs:
    - name: nrf52833
```

## boards/arm/eigen_blec_nrf52833/eigen_blec_nrf52833_defconfig
```kconfig
# CONFIG_SOC_SERIES_NRF52X=y
# CONFIG_SOC_NRF52833_QDAA=y
# CONFIG_BOARD_EIGEN_BLEC_NRF52833=y

# CONFIG_ARM_MPU=y
# CONFIG_HW_STACK_PROTECTION=n

# CONFIG_PINCTRL=y

# SPDX-License-Identifier: Apache-2.0

# Enable MPU
CONFIG_ARM_MPU=y

# enable GPIO
CONFIG_GPIO=y

# enable uart driver
CONFIG_SERIAL=y

# enable console
CONFIG_CONSOLE=y
CONFIG_UART_CONSOLE=y
```
